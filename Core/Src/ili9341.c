#include "ili9341.h"

static SPI_HandleTypeDef *ili_spi;


static const uint8_t font5x7[][5] = {
    {0x00,0x00,0x00,0x00,0x00}, {0x00,0x00,0x5F,0x00,0x00}, {0x00,0x07,0x00,0x07,0x00}, {0x14,0x7F,0x14,0x7F,0x14},
    {0x24,0x2A,0x7F,0x2A,0x12}, {0x23,0x13,0x08,0x64,0x62}, {0x36,0x49,0x55,0x22,0x50}, {0x00,0x05,0x03,0x00,0x00},
    {0x00,0x1C,0x22,0x41,0x00}, {0x00,0x41,0x22,0x1C,0x00}, {0x08,0x2A,0x1C,0x2A,0x08}, {0x08,0x08,0x3E,0x08,0x08},
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    {0x00,0x00,0x7F,0x00,0x00}, {0x00,0x41,0x36,0x08,0x00}, {0x08,0x08,0x2A,0x1C,0x08}
};

static void ILI9341_WriteCommand(uint8_t cmd) {
    HAL_GPIO_WritePin(TFT_DC_GPIO_Port, TFT_DC_Pin, GPIO_PIN_RESET);
    HAL_GPIO_WritePin(TFT_CS_GPIO_Port, TFT_CS_Pin, GPIO_PIN_RESET);
    HAL_SPI_Transmit(ili_spi, &cmd, 1, HAL_MAX_DELAY);
    HAL_GPIO_WritePin(TFT_CS_GPIO_Port, TFT_CS_Pin, GPIO_PIN_SET);
}

static void ILI9341_WriteData(uint8_t data) {
    HAL_GPIO_WritePin(TFT_DC_GPIO_Port, TFT_DC_Pin, GPIO_PIN_SET);
    HAL_GPIO_WritePin(TFT_CS_GPIO_Port, TFT_CS_Pin, GPIO_PIN_RESET);
    HAL_SPI_Transmit(ili_spi, &data, 1, HAL_MAX_DELAY);
    HAL_GPIO_WritePin(TFT_CS_GPIO_Port, TFT_CS_Pin, GPIO_PIN_SET);
}

static void ILI9341_SetWindow(uint16_t x0, uint16_t y0, uint16_t x1, uint16_t y1) {
    ILI9341_WriteCommand(0x2A);
    ILI9341_WriteData(x0 >> 8); ILI9341_WriteData(x0 & 0xFF);
    ILI9341_WriteData(x1 >> 8); ILI9341_WriteData(x1 & 0xFF);
    ILI9341_WriteCommand(0x2B);
    ILI9341_WriteData(y0 >> 8); ILI9341_WriteData(y0 & 0xFF);
    ILI9341_WriteData(y1 >> 8); ILI9341_WriteData(y1 & 0xFF);
    ILI9341_WriteCommand(0x2C);
}

void ILI9341_Init(SPI_HandleTypeDef *hspi) {
    ili_spi = hspi;

    
    HAL_GPIO_WritePin(TFT_RST_GPIO_Port, TFT_RST_Pin, GPIO_PIN_RESET);
    HAL_Delay(10);
    HAL_GPIO_WritePin(TFT_RST_GPIO_Port, TFT_RST_Pin, GPIO_PIN_SET);
    HAL_Delay(120);

   
    ILI9341_WriteCommand(0x01); 
    HAL_Delay(5);
    ILI9341_WriteCommand(0x11);
    HAL_Delay(120);
    ILI9341_WriteCommand(0x3A); 
    ILI9341_WriteData(0x55);   
    ILI9341_WriteCommand(0x36); 
    ILI9341_WriteData(0xA8);    
    ILI9341_WriteCommand(0x29);
    HAL_Delay(120);
}

void ILI9341_FillScreen(uint16_t color) {
    ILI9341_SetWindow(0, 0, 319, 239); 
    HAL_GPIO_WritePin(TFT_DC_GPIO_Port, TFT_DC_Pin, GPIO_PIN_SET);
    HAL_GPIO_WritePin(TFT_CS_GPIO_Port, TFT_CS_Pin, GPIO_PIN_RESET);

    uint8_t data[2] = {color >> 8, color & 0xFF};
    for(uint32_t i = 0; i < 320 * 240; i++) {
        HAL_SPI_Transmit(ili_spi, data, 2, HAL_MAX_DELAY);
    }
    HAL_GPIO_WritePin(TFT_CS_GPIO_Port, TFT_CS_Pin, GPIO_PIN_SET);
}

void ILI9341_DrawPixel(uint16_t x, uint16_t y, uint16_t color) {
    if(x >= 320 || y >= 240) return;
    ILI9341_SetWindow(x, y, x, y);
    HAL_GPIO_WritePin(TFT_DC_GPIO_Port, TFT_DC_Pin, GPIO_PIN_SET);
    HAL_GPIO_WritePin(TFT_CS_GPIO_Port, TFT_CS_Pin, GPIO_PIN_RESET);
    uint8_t data[2] = {color >> 8, color & 0xFF};
    HAL_SPI_Transmit(ili_spi, data, 2, HAL_MAX_DELAY);
    HAL_GPIO_WritePin(TFT_CS_GPIO_Port, TFT_CS_Pin, GPIO_PIN_SET);
}

void ILI9341_DrawChar(uint16_t x, uint16_t y, char c, uint16_t color, uint16_t bg, uint8_t size) {
    if((x >= 320) || (y >= 240) || (c < 32) || (c > 126)) return;
    for(int8_t i = 0; i < 5; i++) {
        uint8_t line = font5x7[c - 32][i];
        for(int8_t j = 0; j < 8; j++) {
            if(line & 0x1) {
                if(size == 1) ILI9341_DrawPixel(x + i, y + j, color);
                else { 
                    for(uint8_t px = 0; px < size; px++)
                        for(uint8_t py = 0; py < size; py++)
                            ILI9341_DrawPixel(x + i*size + px, y + j*size + py, color);
                }
            } else if(bg != color) {
                if(size == 1) ILI9341_DrawPixel(x + i, y + j, bg);
                else {
                    for(uint8_t px = 0; px < size; px++)
                        for(uint8_t py = 0; py < size; py++)
                            ILI9341_DrawPixel(x + i*size + px, y + j*size + py, bg);
                }
            }
            line >>= 1;
        }
    }
}

void ILI9341_FillRectangle(uint16_t x, uint16_t y, uint16_t w, uint16_t h, uint16_t color) {
    for (uint16_t i = x; i < x + w; i++) {
        for (uint16_t j = y; j < y + h; j++) {
            ILI9341_DrawPixel(i, j, color);
        }
    }
}

void ILI9341_DrawText(uint16_t x, uint16_t y, const char *str, uint16_t color, uint16_t bg, uint8_t size) {
    uint16_t start_x = x;
    while(*str) {
        if(*str == '\n') {
            y += 8 * size;
            x = start_x;
        } else {
            ILI9341_DrawChar(x, y, *str, color, bg, size);
            x += 6 * size;
        }
        str++;
    }
}
